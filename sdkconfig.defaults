## sdkconfig.defaults
```kconfig
# Rust often needs a bit of an extra main task stack size compared to C (the default is 3K)
CONFIG_ESP_MAIN_TASK_STACK_SIZE=10000

# Use this to set FreeRTOS kernel tick frequency to 1000 Hz (100 Hz by default).
# This allows to use 1 ms granuality for thread sleeps (10 ms by default).
CONFIG_FREERTOS_HZ=1000

# use internal 8.5MHz oscillator for better frequency stability, the higher
# draw (5uA according to the docs [1]) is not a problem for our use
# [1]: https://docs.espressif.com/projects/esp-idf/en/latest/esp32/api-reference/kconfig.html#config-rtc-clk-src
CONFIG_RTC_CLK_SRC_INT_8MD256=y

# Workaround for https://github.com/espressif/esp-idf/issues/7631
#CONFIG_MBEDTLS_CERTIFICATE_BUNDLE=n
#CONFIG_MBEDTLS_CERTIFICATE_BUNDLE_DEFAULT_FULL=n

CONFIG_FREERTOS_VTASKLIST_INCLUDE_COREID=y
CONFIG_FREERTOS_GENERATE_RUN_TIME_STATS=y
CONFIG_FREERTOS_WATCHPOINT_END_OF_STACK=y
CONFIG_FREERTOS_SUPPORT_DYNAMIC_ALLOCATION=y

CONFIG_LOG_DEFAULT_LEVEL=5

# optional, can be turned off without compile error
# uses more space in the binary but convenient:
CONFIG_ESP_ERR_TO_NAME_LOOKUP=y

CONFIG_LWIP_TCPIP_TASK_STACK_SIZE=8192
```
